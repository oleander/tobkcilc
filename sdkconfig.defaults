## sdkconfig.defaults
```kconfig
CONFIG_ESP_MAIN_TASK_STACK_SIZE=5000

CONFIG_BT_BLUEDROID_ENABLED=n
CONFIG_BT_NIMBLE_ENABLED=y
CONFIG_BT_BLE_ENABLED=y
CONFIG_FREERTOS_HZ=1000
CONFIG_BT_ENABLED=y

CONFIG_BT_NIMBLE_NVS_PERSIST=y
CONFIG_BT_NIMBLE_DEBUG=y
CONFIG_BT_NIMBLE_INFO=n

CONFIG_BT_NIMBLE_SVC_GAP_DEVICE_NAME="key"
CONFIG_NIMBLE_SVC_GAP_DEVICE_NAME="key"
CONFIG_CORE_DEBUG_LEVEL=4
```
